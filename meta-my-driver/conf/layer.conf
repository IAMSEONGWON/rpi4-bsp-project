## meta-my-driver/conf/layer.conf
```bitbake
# We have a conf and classes directory, add to BBPATH
BBPATH .= ":${LAYERDIR}"

# We have recipes-* directories, add to BBFILES
BBFILES += "${LAYERDIR}/recipes-*/*/*.bb \
            ${LAYERDIR}/recipes-*/*/*.bbappend"

BBFILE_COLLECTIONS += "meta-my-driver"
BBFILE_PATTERN_meta-my-driver = "^${LAYERDIR}/"
BBFILE_PRIORITY_meta-my-driver = "6"

LAYERDEPENDS_meta-my-driver = "core"
LAYERSERIES_COMPAT_meta-my-driver = "scarthgap"
```

## meta-my-driver/wic/rpi-ota-ab.wks
```
# short-description: Create Raspberry Pi 4 SD card image with A/B OTA support
# long-description: Creates a partitioned SD card image with /boot, rootfs A, rootfs B, and data partitions.

# 1. Boot Partition (펌웨어 및 부트로더) - 100MB
part /boot --source bootimg-partition --ondisk mmcblk0 --fstype=vfat --label boot --active --align 4096 --fixed-size 100

# 2. Rootfs A (메인 시스템) - 1GB
part / --source rootfs --ondisk mmcblk0 --fstype=ext4 --label rootfs_A --align 4096 --fixed-size 1024

# 3. Rootfs B (백업/업데이트 시스템) - 1GB
part --source rootfs --ondisk mmcblk0 --fstype=ext4 --label rootfs_B --align 4096 --fixed-size 1024

# 4. Data Partition (설정값 저장용) - 512MB
part /data --ondisk mmcblk0 --fstype=ext4 --label data --align 4096 --fixed-size 512
```
